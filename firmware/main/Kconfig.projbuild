## firmware/main/Kconfig.projbuild
```kconfig
menu "Shikong bridge"

config TOY_DEFAULT_URL
    string "Default backend base URL"
    default ""
    help
        Pre-filled in the provisioning form. Overridable at runtime.

config TOY_AP_SSID
    string "Provisioning access point name"
    default "Shikong-Bridge"

config TOY_BUTTON_GPIO
    int "Emergency-stop button GPIO (BOOT button)"
    default 0 if IDF_TARGET_ESP32
    default 9

config TOY_WIFI_TX_POWER_QDBM
    int "Wi-Fi max TX power, in 0.25 dBm"
    range 8 84
    default 78 if IDF_TARGET_ESP32
    default 34
    help
        C3 SuperMini-class boards brown out at full power, so C2/C3 default to 34 (8.5 dBm).
        Classic ESP32-WROOM-32 dev boards have a real module antenna and a stronger regulator: 78 (19.5 dBm).

config TOY_POLL_WAIT_SECONDS
    int "Long-poll hold time requested from the server"
    default 20

endmenu
```

## firmware/sdkconfig.defaults.esp32c3
```kconfig
CONFIG_ESP_CONSOLE_SECONDARY_USB_SERIAL_JTAG=y
CONFIG_ESP_PHY_MAX_WIFI_TX_POWER=10
```
